## firmware/camera/sdkconfig.defaults
```kconfig
CONFIG_IDF_TARGET="esp32s3"
CONFIG_AUTOSTART_ARDUINO=y
CONFIG_FREERTOS_HZ=1000
CONFIG_SPIRAM=y
CONFIG_SPIRAM_MODE_OCT=y
CONFIG_SPIRAM_SPEED_80M=y
CONFIG_SPIRAM_USE_MALLOC=y
CONFIG_ARDUINO_LOOP_STACK_SIZE=16384
CONFIG_PARTITION_TABLE_CUSTOM=y
CONFIG_PARTITION_TABLE_CUSTOM_FILENAME="partitions.csv"
CONFIG_ESPTOOLPY_FLASHSIZE_16MB=y
CONFIG_COMPILER_OPTIMIZATION_PERF=y
CONFIG_FLASH_HUMAN_FACE_DETECT_MSRMNP_S8_V1=y
CONFIG_HUMAN_FACE_DETECT_MSRMNP_S8_V1=y
CONFIG_HUMAN_FACE_DETECT_MODEL_IN_FLASH_RODATA=y
CONFIG_FLASH_HUMAN_FACE_FEAT_MFN_S8_V1=y
CONFIG_HUMAN_FACE_FEAT_MFN_S8_V1=y
CONFIG_HUMAN_FACE_FEAT_MODEL_IN_FLASH_RODATA=y
```
